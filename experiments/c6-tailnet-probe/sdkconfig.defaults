## experiments/c6-tailnet-probe/sdkconfig.defaults
```kconfig
CONFIG_IDF_TARGET="esp32c6"
CONFIG_MBEDTLS_CHACHA20_C=y
CONFIG_MBEDTLS_POLY1305_C=y
CONFIG_MBEDTLS_CHACHAPOLY_C=y
CONFIG_MBEDTLS_HKDF_C=y
CONFIG_MBEDTLS_CERTIFICATE_BUNDLE=y
CONFIG_ML_DERP_VERIFY_CERT=y
CONFIG_ML_MAX_PEERS=16
CONFIG_ML_NVS_MAX_PEERS=16
CONFIG_ML_H2_BUFFER_SIZE_KB=64
CONFIG_ML_JSON_BUFFER_SIZE_KB=64
CONFIG_ML_FILTER_MAX_ENTRIES=64
CONFIG_COMPILER_OPTIMIZATION_SIZE=y
CONFIG_PARTITION_TABLE_SINGLE_APP_LARGE=y
CONFIG_ESPTOOLPY_FLASHSIZE_16MB=y
CONFIG_ESP_TASK_WDT_TIMEOUT_S=30
CONFIG_ML_WIFI_SSID=""
CONFIG_ML_WIFI_PASSWORD=""
CONFIG_ML_TAILSCALE_AUTH_KEY=""
CONFIG_ML_DEVICE_NAME="clawdmeter-c6-probe"
```
